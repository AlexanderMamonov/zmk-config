## config/dts/bindings/behaviors/zmk,behavior-wake-cycle.yaml
```yaml
# Copyright (c) 2026 Aleksandr
# SPDX-License-Identifier: MIT

description: Toggle an eight-hour sequence of periodic key taps
compatible: "zmk,behavior-wake-cycle"
include: zero_param.yaml
```
